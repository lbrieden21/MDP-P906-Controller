## nrf_adapter_source_multiceiver/targets/esp32/main/Kconfig.projbuild
```kconfig
menu "Adapter host link"

choice HOST_LINK
    prompt "Host link"
    default HOST_LINK_USB_JTAG
    help
        Which peripheral carries the binary adapter protocol to the host.

        Do not set this by hand: the Makefile owns it. `make HOST_LINK=...`
        picks the sdkconfig fragment, rejects the impossible combinations with
        a readable message, and gives each choice its own build directory and
        sdkconfig. Editing it in menuconfig instead changes only the current
        configuration and leaves the build id disagreeing with the build.

        This is a Kconfig choice rather than a plain CMake -D variable because
        main/CMakeLists.txt has to select the matching ESP-IDF driver component
        in REQUIRES, and IDF resolves component requirements in a separate
        CMake process that does not inherit -D cache variables. Kconfig symbols
        are forwarded to that pass; cache variables are not.

    config HOST_LINK_USB_JTAG
        bool "Native USB-Serial/JTAG"
        depends on SOC_USB_SERIAL_JTAG_SUPPORTED
        help
            The on-die USB-Serial/JTAG controller, already a CDC-ACM device.
            Default wherever it exists (C6, H2, S3). Not offered on classic
            ESP32, which has no native USB of any kind -- so that chip falls
            through to UART0 below without needing to be special-cased here.

    config HOST_LINK_UART0
        bool "UART0"
        help
            The protocol on UART0, out through the board's USB-to-UART bridge.
            The only option on classic ESP32 (ESP-WROOM-32). Mutually exclusive
            with the ESP-IDF console, which also wants UART0.

endchoice

config HOST_LINK_WIFI
    bool "WiFi host link"
    default n
    depends on SOC_WIFI_SUPPORTED
    help
        Serves the protocol over TCP as well as whichever wired link the
        HOST_LINK choice above selected -- both stay live concurrently, since
        the wired link is how a WiFi build gets provisioned with credentials
        in the first place. Not offered on the H2, which has no WiFi at all
        (802.15.4 + BLE only).

        Do not set this by hand: `make HOST_LINK=HOST_LINK_WIFI` picks the
        sdkconfig fragment and gives this configuration its own build
        directory and sdkconfig, same as the HOST_LINK choice above.

config HOST_LINK_WIFI_PORT
    int "WiFi host link TCP port"
    default 9000
    depends on HOST_LINK_WIFI

endmenu
```
